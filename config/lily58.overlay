/ {
    compatible = "zmk,keyboard";

    display {
        compatible = "ssd1306";
        i2c = <&i2c1>;
        width = <128>;
        height = <32>;
        label = "SSD1306";
        rotation = <0>;
        address = <0x3C>;
    };
};
